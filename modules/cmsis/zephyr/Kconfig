## modules/cmsis/zephyr/Kconfig
```kconfig
# SPDX-License-Identifier: Apache-2.0

source "$(ZEPHYR_CMSIS_MODULE_DIR)/Kconfig"
```

## modules/cmsis_6/zephyr/Kconfig
```kconfig
# SPDX-License-Identifier: Apache-2.0

source "$(ZEPHYR_CMSIS_6_MODULE_DIR)/Kconfig"
```

## modules/hal_infineon/zephyr/Kconfig
```kconfig
# SPDX-License-Identifier: Apache-2.0

source "$(ZEPHYR_HAL_INFINEON_MODULE_DIR)/Kconfig"
```

## modules/littlefs/zephyr/Kconfig
```kconfig
# SPDX-License-Identifier: Apache-2.0

source "$(ZEPHYR_LITTLEFS_MODULE_DIR)/Kconfig"
```
